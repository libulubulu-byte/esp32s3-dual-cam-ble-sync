## main/Kconfig.projbuild
```kconfig
menu "Dual Cam BLE Sync Configuration"

choice BOARD_ROLE
    prompt "Board role"
    default BOARD_ROLE_SLAVE
    help
      Select board role: host or slave

config BOARD_ROLE_HOST
    bool "Host (Central)"
    help
      Act as BLE Central - scans and connects to slave, receives UART commands

config BOARD_ROLE_SLAVE
    bool "Slave (Peripheral)"
    help
      Act as BLE Peripheral - advertises and waits for host connection

endchoice

endmenu
```

## sdkconfig.defaults
```kconfig
CONFIG_IDF_TARGET="esp32s3"

# ---------- PSRAM ----------
CONFIG_SPIRAM=y
CONFIG_SPIRAM_MODE_OCT=y
CONFIG_SPIRAM_SPEED_80M=y
CONFIG_SPIRAM_USE_MALLOC=y
CONFIG_SPIRAM_MALLOC_ALWAYSINTERNAL=16384
CONFIG_SPIRAM_TRY_ALLOCATE_WIFI_LWIP=n
CONFIG_SPIRAM_MALLOC_RESERVE_INTERNAL=32768
CONFIG_SPIRAM_RODATA=y
CONFIG_SPIRAM_XIP_FROM_PSRAM=y
CONFIG_SPIRAM_FETCH_INSTRUCTIONS=y

# ---------- Flash ----------
CONFIG_ESPTOOLPY_FLASHSIZE_16MB=y
CONFIG_ESPTOOLPY_FLASHMODE_QIO=y
CONFIG_ESPTOOLPY_FLASHFREQ_80M=y

# ---------- System ----------
CONFIG_FREERTOS_HZ=1000
CONFIG_ESP_MAIN_TASK_STACK_SIZE=8192
CONFIG_ESP_TASK_WDT_TIMEOUT_S=10

# ---------- FATFS ----------
CONFIG_FATFS_LFN_HEAP=y
CONFIG_FATFS_MAX_LFN=255
CONFIG_FATFS_API_ENCODING_UTF_8=y
CONFIG_FATFS_VOLUME_COUNT=2

# ---------- Partition table ----------
CONFIG_PARTITION_TABLE_CUSTOM=y
CONFIG_PARTITION_TABLE_CUSTOM_FILENAME="partitions.csv"

# ---------- Camera (OV3660) ----------
CONFIG_CAM_OV3660=y
CONFIG_OV3660_SUPPORT=y
# CONFIG_CAM_OV2640_SUPPORT is not set
# CONFIG_CAM_OV5640_SUPPORT is not set
# CONFIG_OV2640_SUPPORT is not set
# CONFIG_OV7670_SUPPORT is not set
# CONFIG_OV7725_SUPPORT is not set
# CONFIG_NT99141_SUPPORT is not set
# CONFIG_OV3640_SUPPORT is not set
# CONFIG_OV5640_SUPPORT is not set
# CONFIG_CAMERA_AF_SUPPORT is not set
# CONFIG_GC2145_SUPPORT is not set
# CONFIG_GC032A_SUPPORT is not set
# CONFIG_GC0308_SUPPORT is not set
# CONFIG_BF3005_SUPPORT is not set
# CONFIG_BF20A6_SUPPORT is not set
# CONFIG_SC101IOT_SUPPORT is not set
# CONFIG_SC101IOT_720P_15FPS_ENABLED is not set
# CONFIG_SC101IOT_VGA_25FPS_ENABLED is not set
# CONFIG_SC030IOT_SUPPORT is not set
# CONFIG_SC031GS_SUPPORT is not set
# CONFIG_HM1055_SUPPORT is not set
# CONFIG_HM0360_SUPPORT is not set
# CONFIG_MEGA_CCM_SUPPORT is not set
# CONFIG_CAMERA_CONVERTER_ENABLED is not set
CONFIG_CAMERA_FB_COUNT=2
CONFIG_CAMERA_FB_LOCATION=PSRAM
CONFIG_XCLK_DEFAULT_FREQ=20000000
CONFIG_CAMERA_DMA_BUFFER_SIZE=1024

# ---------- SDMMC ----------
CONFIG_SOC_SDMMC_USE_IOMUX=y
CONFIG_SDMMC_USE_GPIO_MATRIX=n

# ---------- BLE (NimBLE) ----------
CONFIG_BT_ENABLED=y
CONFIG_BT_BLUEDROID_ENABLED=n
CONFIG_BT_NIMBLE_ENABLED=y
CONFIG_BT_CONTROLLER_ENABLED=y
CONFIG_BT_NIMBLE_ROLE_PERIPHERAL=y
CONFIG_BT_NIMBLE_ROLE_BROADCASTER=y
CONFIG_BT_NIMBLE_ROLE_CENTRAL=y
CONFIG_BT_NIMBLE_ROLE_OBSERVER=n
CONFIG_BT_NIMBLE_MAX_CONNECTIONS=2
CONFIG_BT_NIMBLE_GAP_DEVICE_NAME="DUAL-CAM"
CONFIG_BT_NIMBLE_MSYS_1_BLOCK_COUNT=32
CONFIG_BT_NIMBLE_ATT_PREFERRED_MTU=247
CONFIG_BT_NIMBLE_NVS_PERSIST=n
CONFIG_BT_NIMBLE_LOG_LEVEL_WARNING=y
CONFIG_BT_NIMBLE_HOST_TASK_STACK_SIZE=5120
CONFIG_BT_NIMBLE_MEM_ALLOC_MODE_EXTERNAL=y
CONFIG_BT_CTRL_BLE_MAX_ACT=2
CONFIG_BT_CTRL_BLE_ADV_REPORT_FLOW_CTRL_NUM=8
CONFIG_BT_CTRL_SCAN_DUPL_CACHE_SIZE=8
CONFIG_ESP_COEX_SW_COEXIST_ENABLE=y

# ---------- WiFi + TLS（Telegram 照片上传） ----------
CONFIG_ESP_WIFI_ENABLED=y
CONFIG_ESP_HTTP_CLIENT_ENABLE_HTTPS=y
CONFIG_MBEDTLS_CERTIFICATE_BUNDLE=y
CONFIG_MBEDTLS_CERTIFICATE_BUNDLE_DEFAULT_FULL=y
# ★ mbedtls 的内存改用 PSRAM：默认"只用内部 RAM"，而一条 TLS 会话
#   (SSL_IN 16KB + SSL_OUT 4KB + 上下文 4KB) 就要 24KB，内部 RAM 只有 ~250KB，
#   跑几张照片就会 mbedtls_ssl_setup -0x7F00 (ALLOC_FAILED)。
CONFIG_MBEDTLS_EXTERNAL_MEM_ALLOC=y
CONFIG_ESP_WIFI_STATIC_RX_BUFFER_NUM=10
CONFIG_ESP_WIFI_DYNAMIC_RX_BUFFER_NUM=16
CONFIG_ESP_WIFI_STATIC_TX_BUFFER_NUM=8
CONFIG_ESP_WIFI_CACHE_TX_BUFFER_NUM=16
CONFIG_ESP_WIFI_RX_BA_WIN=8

# ---------- Console ----------
CONFIG_ESP_CONSOLE_UART_NUM=0
CONFIG_ESP_CONSOLE_UART_BAUDRATE=115200

# ---------- Logging ----------
CONFIG_LOG_DEFAULT_LEVEL_INFO=y
CONFIG_LOG_MAXIMUM_LEVEL_INFO=y
```
